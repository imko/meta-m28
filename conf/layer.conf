## conf/layer.conf
```bitbake
# We have a conf and classes directory, add to BBPATH
BBPATH .= ":${LAYERDIR}"

# We have a recipes-* directories, add to BBFILES
BBFILES += "${LAYERDIR}/recipes-*/*/*.bb \
	${LAYERDIR}/recipes-*/*/*.bbappend"

BBFILE_COLLECTIONS += "m28"
BBFILE_PATTERN_m28 = "^${LAYERDIR}/"
BBFILE_PRIORITY_m28 = "6"
```

## conf/machine/m28.conf
```bitbake
#@TYPE: Machine
#@NAME: DENX M28 SoM Evaluation Kit
#@SOC: i.MX28
#@DESCRIPTION: Machine configuration for DENX M28 CoM Evaluation Kit

# CPU and ABI tuning
include conf/machine/include/tune-arm926ejs.inc

# Preferred providers
PREFERRED_PROVIDER_u-boot = "u-boot"
PREFERRED_PROVIDER_virtual/kernel = "linux-mainline"

# Settings for u-boot
UBOOT_MACHINE = "m28evk_config"
UBOOT_ENTRYPOINT = "0x42000000"

# Settings for Linux Kernel
KERNEL_IMAGETYPE = "uImage"
KERNEL_DEVICETREE = "${S}/arch/arm/boot/dts/imx28-m28evk.dts"

# RootFS Image settings
IMAGE_FSTYPES = "tar.bz2 ext3 jffs2 ubi sdcard"
SDCARD_ROOTFS = "${DEPLOY_DIR_IMAGE}/${IMAGE_NAME}.rootfs.ext3"
EXTRA_IMAGECMD_jffs2 = "-lnp "
MKUBIFS_ARGS = "-m 2048 -e 124KiB -c 124 -x favor_lzo"
UBINIZE_ARGS = "-m 2048 -p 128KiB -s 2048 -O 2048"

# Serial console settings for sysvinit and systemd
SERIAL_CONSOLE = "115200 ttyAMA0"

# Build the u-boot
EXTRA_IMAGEDEPENDS += "u-boot"

# Add the sdcard image format
IMAGE_CLASSES += "image_types_sdcard"

# Ship all kernel modules and include mtd utils
MACHINE_EXTRA_RRECOMMENDS = "kernel-modules mtd-utils"

# Some extra features of the m28
MACHINE_FEATURES = "apm usbgadget usbhost vfat alsa"
```
